## CMakeLists.txt
```
#
# Copyright (c) 2016-2024 Makerdiary <https://makerdiary.com>
# SPDX-License-Identifier: Apache-2.0
#

cmake_minimum_required(VERSION 3.20.0)
find_package(Zephyr REQUIRED HINTS $ENV{ZEPHYR_BASE})
project(shell)

target_sources(app PRIVATE src/main.c)
```

## sample.yaml
```
sample:
  name: Basic Shell Sample
common:
  build_only: true
  integration_platforms:
    - imxrt1011_nanokit
tests:
  sample.shell: {}
```

## prj.conf
```kconfig
#
# Copyright (c) 2016-2024 Makerdiary <https://makerdiary.com>
#
# SPDX-License-Identifier: Apache-2.0
#

CONFIG_SHELL=y

CONFIG_INIT_STACKS=y
CONFIG_THREAD_STACK_INFO=y
CONFIG_KERNEL_SHELL=y
CONFIG_THREAD_MONITOR=y
CONFIG_THREAD_NAME=y
CONFIG_DEVICE_SHELL=y
CONFIG_POSIX_CLOCK=y
CONFIG_DATE_SHELL=y
CONFIG_THREAD_RUNTIME_STATS=y
CONFIG_THREAD_RUNTIME_STATS_USE_TIMING_FUNCTIONS=y
CONFIG_STATS=y
CONFIG_STATS_SHELL=y

# To build the sample when working with the UF2 Bootloader
CONFIG_BUILD_OUTPUT_UF2=y
```

## boards/imxrt1011_nanokit.overlay
```dts
/*
 * Copyright (c) 2016-2024 Makerdiary <https://makerdiary.com>
 *
 * SPDX-License-Identifier: Apache-2.0
 */

/ {
    chosen {
        zephyr,console = &cdc_acm_uart0;
        zephyr,shell-uart = &cdc_acm_uart0;
    };
};

&zephyr_udc0 {
    cdc_acm_uart0: cdc_acm_uart0 {
        compatible = "zephyr,cdc-acm-uart";
    };
};
```

## src/main.c
```c
/*
 * Copyright (c) 2016-2024 Makerdiary <https://makerdiary.com>
 * SPDX-License-Identifier: Apache-2.0
 */

#include <zephyr/kernel.h>
#include <zephyr/shell/shell.h>

#define DBL_TAP_MAGIC            0xf01669ef /* Enter DFU magic */
#define DBL_TAP_MAGIC_QUICK_BOOT 0xf02669ef /* Skip double tap delay detection */
#define DBL_TAP_MAGIC_ERASE_APP  0xf5e80ab4 /* Erase entire application !! */

int main(void)
{
	return 0;
};

static int cmd_bootloader(const struct shell *sh, size_t argc, char **argv)
{
	ARG_UNUSED(argc);
	ARG_UNUSED(argv);


	SNVS->LPGPR[3] = DBL_TAP_MAGIC;

	shell_print(sh, "Enter UF2 Bootloader...");

	NVIC_SystemReset();

	return 0;
}

static int cmd_erase_app(const struct shell *sh, size_t argc, char **argv)
{
	ARG_UNUSED(argc);
	ARG_UNUSED(argv);


	SNVS->LPGPR[3] = DBL_TAP_MAGIC_ERASE_APP;

	shell_print(sh, "Don't turn off the power! Erasing entire application...");

	NVIC_SystemReset();

	return 0;
}

SHELL_CMD_ARG_REGISTER(bootloader, NULL, "Enter UF2 Bootloader", cmd_bootloader, 1, 0);
SHELL_CMD_ARG_REGISTER(erase_app, NULL, "Erase entire application", cmd_erase_app, 1, 0);
```
