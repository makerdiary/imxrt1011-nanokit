## CMakeLists.txt
```
#
# Copyright (c) 2016-2024 Makerdiary <https://makerdiary.com>
#
# SPDX-License-Identifier: Apache-2.0
#

cmake_minimum_required(VERSION 3.20.0)

find_package(Zephyr REQUIRED HINTS $ENV{ZEPHYR_BASE})
project(hello_world)

target_sources(app PRIVATE src/main.c)
```

## sample.yaml
```
sample:
  name: Hello World Sample
common:
  build_only: true
  integration_platforms:
    - imxrt1011_nanokit
tests:
  sample.hello_world: {}
  sample.hello_world.nouf2:
    extra_args: EXTRA_CONF_FILE=overlay-nouf2.conf
```

## prj.conf
```kconfig
# nothing here

# To build the sample when working with the UF2 Bootloader
CONFIG_BUILD_OUTPUT_UF2=y
```

## src/main.c
```c
/*
 * Copyright (c) 2012-2014 Wind River Systems, Inc.
 * Copyright (c) 2016-2024 Makerdiary <https://makerdiary.com>
 *
 * SPDX-License-Identifier: Apache-2.0
 */

#include <zephyr/kernel.h>
#include <stdio.h>

int main(void)
{
	while (1) {
		printf("Hello World! %s\n", CONFIG_BOARD_TARGET);
		k_sleep(K_SECONDS(1));
	}

	return 0;
}
```
