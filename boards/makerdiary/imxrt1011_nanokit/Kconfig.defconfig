## boards/makerdiary/imxrt1011_nanokit/Kconfig.defconfig
```kconfig
# Copyright (c) 2016-2024 Makerdiary <https://makerdiary.com>
# SPDX-License-Identifier: Apache-2.0

if BOARD_IMXRT1011_NANOKIT

config BUILD_OUTPUT_HEX
	default y

if BUILD_OUTPUT_UF2

config FLASH_LOAD_OFFSET
	default 0xC000

config BUILD_OUTPUT_UF2_USE_FLASH_BASE
	default y

config BUILD_OUTPUT_UF2_USE_FLASH_OFFSET
	default y

config NXP_IMXRT_BOOT_HEADER
	default n

endif # BUILD_OUTPUT_UF2

endif # BOARD_IMXRT1011_NANOKIT
```

## boards/makerdiary/imxrt1011_nanokit/Kconfig.imxrt1011_nanokit
```kconfig
# Copyright (c) 2016-2024 Makerdiary <https://makerdiary.com>
# SPDX-License-Identifier: Apache-2.0

config BOARD_IMXRT1011_NANOKIT
    select SOC_PART_NUMBER_MIMXRT1011DAE5A
```

## boards/makerdiary/imxrt1011_nanokit/board.yml
```yaml
board:
  name: imxrt1011_nanokit
  vendor: makerdiary
  socs:
    - name: mimxrt1011
```

## dts/bindings/makerdiary-header-40.yaml
```yaml
#
# Copyright (c) 2016-2024 Makerdiary <https://makerdiary.com>
# SPDX-License-Identifier: Apache-2.0
#

description: |
    GPIO pins exposed on Makerdiary Headers (40 Pins).

    This binding provides a nexus mapping for the default 31 pins as depicted below:

        -  VBUS              3V3   -
        -  VSYS              GND   -
        -  GND               RST   -
        -  3V3_EN            SWCLK -
        0  IO0               SWDIO -
        1  IO1               IO30  30
        2  IO2               IO29  29
        3  IO3               IO28  28
        4  IO4               IO27  27
        5  IO5               IO26  26
        6  IO6               IO25  25
        7  IO7               IO24  24
        8  IO8               IO23  23
        9  IO9               IO22  22
        10 IO10              IO21  21
        11 IO11              IO20  20
        12 IO12              IO19  19
        13 IO13              IO18  18
        14 IO14              IO17  17
        15 IO15              IO16  16

compatible: "makerdiary-header-40"

include: [gpio-nexus.yaml, base.yaml]
```

## samples/zephyr/button/sample.yaml
```yaml
sample:
  name: Button Sample
common:
  build_only: true
  integration_platforms:
    - imxrt1011_nanokit
tests:
  sample.button: {}
  sample.button.nouf2:
    extra_args: EXTRA_CONF_FILE=overlay-nouf2.conf
```

## west.yml
```yaml
# Copyright (c) 2016-2024 Makerdiary <https://makerdiary.com>
# SPDX-License-Identifier: Apache-2.0

manifest:
  self: 
    path: imxrt1011-nanokit
  remotes:
    - name: makerdiary
      url-base: https://github.com/makerdiary
    - name: zephyrproject-rtos
      url-base: https://github.com/zephyrproject-rtos

  projects:
    - name: zephyr
      remote: zephyrproject-rtos
      revision: main
      import:
        # By using name-allowlist we can clone only the modules that are
        # strictly needed by the application.
        name-allowlist:
          - cmsis      # required by the ARM port
          - hal_nxp    # required by the NXP chip based boards
          - mbedtls
          - lvgl
          - fatfs
          - littlefs
```
